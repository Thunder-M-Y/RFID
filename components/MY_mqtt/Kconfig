## components/MY_mqtt/Kconfig
```kconfig
menu "MQTT Configure"
    config MQ_BROKER_URL
        string "MQTT Broker URL"
        default "mqtt://"
        help
          MQTT Broker URL
    config MQ_BROKER_PORT
        int "MQTT Broker Port"
        default 1883
        help
          MQTT Broker Port
    config MQ_BROKER_USER   
        string "MQTT Broker User"
        default ""
        help
          MQTT Broker User
    config MQ_BROKER_PASSWD
        string "MQTT Broker Password"
        default ""
        help
          MQTT Broker Password
    config MQ_CLIENTID
        string "MQTT Client ID"
        default ""
        help
          MQTT Client ID
    config MQ_PRODUCTKEY
        string "MQTT Product Key"
        default ""
        help
          MQTT Product Key
    config MQ_DEVICENAME
        string "MQTT Device Name"
        default ""
        help
          MQTT Device Name
    config MQ_DEVICESECRET
        string "MQTT Device Secret"
        default ""
        help
          MQTT Device Secret
endmenu
```

## components/MY_wifi/Kconfig
```kconfig
menu "Mars-WiFi Configuration"
    choice MWF_MODE
        prompt "Working mode of WiFi"
        default MWF_MODE_STA
        help
            Please select the working mode of WiFi
            AP - WiFi as AP
            STA - WiFi working in Station mode
        config MWF_MODE_AP
            bool "AP"
        config MWF_MODE_STA
            bool "STA"
    endchoice
    config MWF_SSID
        string "SSID"
        default "3203"
        help
            If working in AP mode, this parameter is the SSID used to start the AP
            If working in STA mode, this parameter is the SSID used to connect to the AP
    config MWF_PASSWROD
        string "Password"
        default "32033203"
        help 
            If working in AP mode, this parameter is the password used to start the AP
            If working in STA mode, this parameter is the password used to connect to the AP
endmenu
```
